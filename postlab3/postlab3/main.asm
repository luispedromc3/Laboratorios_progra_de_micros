;
; UNIVERSIDAD DEL VALLE DE GUATEMALA
;PROGRAMACION DE MICROCONTROLADORES
;
; Created: 2/19/2025 4:26:36 PM
; Author : LUIS PEDRO MONTERROSO CAMPOS
;HARDWARE: ATMEGA328PB
;LABORATORIO 3

.include"M328PBDEF.inc"
.cseg
.org 0x0000
	RJMP		INICIAR

.ORG		PCINT0addr				// INTERRUPCION PCINT0 (on-change)
    RJMP		ISR_ON_CHANGE		// ISR 

.org	TIMER0_OVFaddr				//interrupcion del timer0
	RJMP		ISR_TIMER0

 

.def	CONTADOR = R25 
.DEF	COUNTER = R24
.DEF	UNIDADES = R23
.DEF	DECENAS = R22
.DEF	CONTADOR_SEGUNDOS = R18
.DEF	CONTADOR_DECENAS = R19


INICIAR:
	//configuracion de la pila
	LDI		R16, LOW(RAMEND)
	OUT		SPL, R16 //CARGAR 0XFF A SPL(STACK POINTER LOW)
	LDI		R16, HIGH(RAMEND)
	OUT		SPH, R16 //CARGAR 0X08 A SPH(STACK POINTER HIGH)
	//-------------------------------------------------------------------------------CONFIGURAMOS DIRECCIONAMIENTO---------------------------
	//LLENAR X CON LOS VALORES DEL DISPLAY
	LDI		XL, 0x00
	LDI		XH, 0x01
	.equ	SIZE = 17 //
	TABLA:	.db 0X7E, 0X30,0X6D,0X79,0X33,0X5B,0X5F,0X70,0X7F,0X7B
	LDI		ZH, HIGH(TABLA << 1)
	LDI		ZL, LOW(TABLA << 1)
	LDI		XH, 0X01
	LDI		XL, 0X00
	LDI		YH, 0X01
	LDI		YL, 0X00
	LDI		R21, SIZE
	COPIAR: 
			LPM		R22,Z+
			DEC		R21
			CPI		R21,0
			BREQ	SETUP
			ST		X+,R22
			//ST		Y+,R22
			RJMP	COPIAR
SETUP:
	CLI		//DESHABILITO LAS INTERRUPCIONES
	//VUELVO A APUNTAR LOS PUNTEROS A CERO
	LDI		XL, 0x00
	LDI		XH, 0x01
	LDI		YL, 0x00
	LDI		YH, 0x01
	//--------------------------------------------------SETUP DE LA FRECUENCIA DE TODO EL MC------------------------
    LDI     R16, (1 << CLKPCE)
    STS     CLKPR, R16          // Habilitar cambio de PRESCALER
    LDI     R16, 0b00000100		// 2^4 = 16 ES DECIR DIVIDIMOS 16MHz ENTRE 16
    STS     CLKPR, R16          // Configurar Prescaler a 1MHz
	//--------------------------------------------------SETUP DEL TIMER
	CALL    INIT_TMR0
	// DESACTIVAR UART PARA QUE NO EMPIECEN ENCENDIDOS LOS PRIMEROS DOS BITS DEL PORTD
	//DESACTIVAR UART
	LDI		R16, 0x00  
    STS		UCSR0B, R16  ; Deshabilitar transmisión y recepción  
	//CONFIGURAR PUERTO D COMO SALIDA
	LDI		R16, 0xFF
	OUT		DDRD, R16 // CONFIGURAMOS PUERTO D COMO SALIDA
	LDI		R16, 0x00
	OUT		PORTD, R16 // LEDS APAGADOS
	//MASCARA DE TIMER0
	LDI		R16, (1<<TOIE0)			//MASCARA PARA ACTIVAR EL TIMER EN MODO NORMAL
	STS		TIMSK0, R16
	//CONFIGURAR PUERTO B COMO ENTRADA CON PULL UPS HABILITADOS
	LDI		R16, 0x00
	OUT		DDRB, R16 // CONFIGURAMOS PUERTO B COMO ENTRADA
	LDI		R16, 0xFF
	OUT		PORTB, R16 //HABILITAMOS PULL-PUS
	//PUERTO C COMO SALIDA DE LOS LEDS Y TRANSISTORES
	LDI		R16, 0xFF
	OUT		DDRC, R16 // CONFIGURAMOS PUERTO C SALIDA
	LDI		R16, 0B00010000
	OUT		PORTC, R16 // LEDS APAGADOS Y UN DISPLAY ENCENDIDO
	
	//HABILITAR INTERRUPCIONES EN PORTB
	LDI		R16, (1 << PCIE0)             // Habilitar PCINT en PORTB
    STS		PCICR, R16
    LDI		R16, (1 << PCINT3) | (1 << PCINT4)	// INTERRUPCIONES EN PB3 Y PB4
    STS		PCMSK0, R16 //MASCARA PARA COLOCAR LAS INTERRUPCIONES EN PB3 Y PB4
	
	//INICIO TODOS LOS CONTADORES EN CERO

	LDI		CONTADOR, 0x00
	LDI		DECENAS, 0X00
	LDI		UNIDADES, 0X00  
	LDI		CONTADOR_SEGUNDOS, 0X00
	LDI		CONTADOR_DECENAS, 0X00 

	SEI			//VUELVO A ACTIVAR LAS INTERRUPCIONES
LOOP:
	CPI     COUNTER, 100        // COUNTER = 100 DESPUES DE 1s (TCNT0 SET CADA 10MS)
	BREQ	AUMENTAR_SEGUNDOS
	RJMP	LOOP

AUMENTAR_SEGUNDOS:
	CLR		COUNTER			//LIMPIO EL CONTADOR DE MILISEGUNDOS
	INC		CONTADOR_SEGUNDOS	//AUMENTO SEGUNDOS
	CPI		CONTADOR_SEGUNDOS, 10
	BREQ	AUMENTAR_DECENAS
	ADIW	X,1
	RJMP	LOOP
AUMENTAR_DECENAS:
	CLR		CONTADOR_SEGUNDOS	//LIMPIO LOS SEGUNDOS
	LDI		XL, 0x00			//VUELVO A APUNTAR EL PUNTERO DE SEGUNDOS A CERO
	LDI		XH, 0x01
	INC		CONTADOR_DECENAS		//AGREGO UNA DECENA DE SEGUNDOS
	CPI		CONTADOR_DECENAS, 6		//VERIFICO SI YA PASARON 60s
	BREQ	LIMPIAR_CLK
	ADIW	Y,1
	RJMP	LOOP
LIMPIAR_CLK:
	CLR		CONTADOR_DECENAS
	LDI		YL, 0x00
	LDI		YH, 0x01
	RJMP	LOOP	
//-----------------------------------------RUTINAS DE TIMER-----------------------------
INIT_TMR0:
    LDI     R16, (1<<CS01) | (1<<CS00)
    OUT     TCCR0B, R16         // Setear prescaler del TIMER 0 a 64 TCCTBOB = 0000 0011
    LDI     R16, 100			// CON ESTE VALOR, TCNT0 ESTARA SET CADA 10MS      
    OUT     TCNT0, R16          // Cargar valor inicial en TCNT0
    RET

//-----------------------------------------RUTINAS DE INTERRUPCION-----------------------

ISR_TIMER0:
	PUSH	R17
	IN		R17, SREG
	PUSH	R17


	SBI     TIFR0, TOV0         // Limpiar bandera de "overflow"
	LDI     R17, 100            
    OUT     TCNT0, R17          // Volver a cargar valor inicial en TCNT0
    
	INC		COUNTER				//INCREMENTO EL CONTADOR DE SEGUNDOS
	//TOGGLE A LOS DISPLAYS
	SBI		PINC,4 
	SBI		PINC,5		
	//NOP
	//NOP
	//TOGGLE DE LOS DISPLAYS
	SBIS	PORTC, 5
	RJMP	DISPLAY_DECENAS
	//----------------------------------------DISPLAY DE UNIDADES
DISPLAY_UNIDADES:
	LD		UNIDADES, X
	OUT		PORTD, UNIDADES
	RJMP	SALIR
	//---------------------------------------------------BLOQUE DE DISPLAY DE DECENAS-------------------------------------
DISPLAY_DECENAS:
	LD		DECENAS, Y
	OUT		PORTD, DECENAS
	RJMP	SALIR
SALIR:
	POP		R17
	OUT		SREG, R17
	POP		R17
	RETI


//----------------------------------------------  RUTINA DE INTERRUPCIÓN BOTONES-------------------------------
ISR_ON_CHANGE:
	PUSH		R16
	IN			R16, SREG
	PUSH		R16
    IN			R16, PINB			//LEER PORTB
    SBRS		R16, PORTB3			// Si PB3 está en bajo (botón incrementar presionado)
	INC			CONTADOR     
    SBRS		R16, PORTB4			// Si PB4 está en bajo (botón decrementar presionado)
	DEC			CONTADOR
	ANDI		CONTADOR, 0x0F
	IN			R16, PORTC
	ANDI		R16, 0x30
	ADD			R16, CONTADOR
	OUT			PORTC, R16
	//ANDI		CONTADOR, 0X3F // 0b00111111
	//OUT			PORTC, CONTADOR
	POP			R16
	OUT			SREG, R16
	POP			R16
    RETI					// Sale de la interrupción

