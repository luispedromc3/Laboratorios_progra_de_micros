;
; PROYECTO1.asm
;
; Created: 3/10/2025 5:31:45 PM
; Author : luisp
;


; Replace with your application code
.include"M328PBDEF.inc"
.cseg
.org 0x0000
	RJMP		SETUP

.ORG		PCINT0addr				// INTERRUPCION PCINT0 (on-change) PORTB
    RJMP		ISR_ON_CHANGE		// ISR 

.org	TIMER0_OVFaddr				//interrupcion del timer0
	RJMP		ISR_TIMER0
//TABLA CON VALORES DEL DISPLAY
TABLA:	.db 0X7E, 0X30,0X6D,0X79,0X33,0X5B,0X5F,0X70,0X7F,0X7B
//---------------------------DEFINIMOS VARIABLES QUE UTILIZACEMOS---------------------------
.equ	CANTIDAD_MODOS		= 4
.EQU	UNA_HORA			= 60
.EQU	UN_MIN				= 60
.equ	VALOR_TCNT0			= 178		//INTERRUPCIONES CADA 5ms
//.DEF	PARPADEO_MODOS		= R26
.DEF	COUNTER_ALARMA		= R25
.DEF	BANDERA_CONFALARMA	= R24
.DEF	BANDERA_CONFFECHA	= R23
.DEF	COUNTER				= R22
.DEF	BANDERA_CONFHORA	= R21
.DEF	BANDERA_TIEMPO		= R20
.DEF	TRANSISTORES		= R19
.DEF	MODO				= R18
.DEF	CONTADOR_PARPADEO	= R15
.DEF	UNIDADES_MIN		= R14
.DEF	DECENAS_MIN			= R13
.DEF	UNIDADES_HORAS		= R12
.DEF	DECENAS_HORAS		= R11
.DEF	SEGUNDERO			= R10
.DEF	UNIDADES_DIAS		= R9
.DEF	DECENAS_DIAS		= R8
.DEF	UNIDADES_MESES		= R7
.DEF	DECENAS_MESES		= R6
.DEF	UNIDADES_M_ALARMA	= R5
.DEF	DECENAS_M_ALARMA	= R4
.DEF	UNIDADES_H_ALARMA	= R3
.DEF	DECENAS_H_ALARMA	= R2
//------------------------------------------------------------------------------------------
//SETUP
SETUP: 
	CLI
//CONFIGURACION DE LA PILA
	LDI		R16, LOW(RAMEND)
	OUT		SPL, R16			//CARGAR 0XFF A SPL(STACK POINTER LOW)
	LDI		R16, HIGH(RAMEND)
	OUT		SPH, R16			//CARGAR 0X08 A SPH(STACK POINTER HIGH)
//--------------------------------------------------SETUP DE LA FRECUENCIA DE TODO EL MC------------------------
    
	LDI     R16, (1 << CLKPCE)
    STS     CLKPR, R16          // Habilitar cambio de PRESCALER
    LDI     R16, 0b00000100		// 2^4 = 16 ES DECIR DIVIDIMOS 16MHz ENTRE 16
    STS     CLKPR, R16          // Configurar Prescaler a 1MHz
	
	//lo voy a dejar a 16MHz para evitar retrasos por muchas instrucciones
//--------------------------------------------------SETUP DEL TIMER--------------------------------------------------
	CALL    INIT_TMR0
	// DESACTIVAR UART PARA QUE NO EMPIECEN ENCENDIDOS LOS PRIMEROS DOS BITS DEL PORTD
	//DESACTIVAR UART
	LDI		R16, 0x00  
    STS		UCSR0B, R16  ; Deshabilitar transmisiСn y recepciСn  
	//DEFINIMOS LOS PUERTOS 
	//-------------------------------------------------PORT D-------------------------------------------------
	LDI		R16, 0xFF
	OUT		DDRD, R16 // CONFIGURAMOS PUERTO D COMO SALIDA
	LDI		R16, 0x00
	OUT		PORTD, R16 // LEDS APAGADOS
	//-------------------------------------------------PORT B-------------------------------------------------
	LDI		R16, 0B00100001		//PB0 Y PB5 SALIDAS, LOS DEMAS ENTRADAS
	OUT		DDRB, R16 
	LDI		R16, 0B00011110		//HABILITO PULL-UPS PARA LAS ENTRADAS Y APAGO LAS SALIDAS
	OUT		PORTB, R16	
	//-------------------------------------------------PORT C-------------------------------------------------
	LDI		R16, 0xFF
	OUT		DDRC, R16 // CONFIGURAMOS PUERTO D COMO SALIDA
	//LDI		R16, 0b00001010
	LDI		R16, 0X00
	OUT		PORTC, R16 // LEDS APAGADOS
	//MASCARA DE TIMER0
	LDI		R16, (1<<TOIE0)														//MASCARA PARA ACTIVAR EL TIMER EN MODO NORMAL
	STS		TIMSK0, R16
	//HABILITAR INTERRUPCIONES EN PORTB
	LDI		R16, (1 << PCIE0)													// Habilitar PCINT en PORTB
    STS		PCICR, R16
    LDI		R16, (1 << PCINT3) | (1 << PCINT4)| (1 << PCINT1)| (1 << PCINT2)	// INTERRUPCIONES EN PB3 Y PB4
    STS		PCMSK0, R16															//APLICAR MASCARA 
	//INICIALIZAR VARIABLES EN CERO
	CLR		R1
	CLR		R16
	CLR		COUNTER
	CLR		CONTADOR_PARPADEO
	CLR		MODO
	CLR		UNIDADES_MIN
	CLR		DECENAS_MIN
	CLR		UNIDADES_HORAS
	CLR		DECENAS_HORAS
	CLR		SEGUNDERO
	CLR		TRANSISTORES
	LDI		BANDERA_TIEMPO, 0B00000001		//BANDERA CONTAR TIEMPO ENCENDIDA
	CLR		BANDERA_CONFHORA
	LDI		R16, 1
	MOV		UNIDADES_DIAS, R16
	MOV		UNIDADES_MESES,R16
	CLR		DECENAS_DIAS
	CLR		DECENAS_MESES
	CLR		BANDERA_CONFFECHA
	CLR		BANDERA_CONFALARMA
	CLR		UNIDADES_M_ALARMA
	CLR		DECENAS_M_ALARMA
	CLR		UNIDADES_H_ALARMA
	CLR		DECENAS_H_ALARMA
	CLR		COUNTER_ALARMA
	CLR		R26
	SEI
/*FUNCIONAMIENTO DE MI LOOP PRINCIPAL:
	EN ESTE LOOP SE PARPADEA Y CUENTA LA FECHA SIEMPRE, SIN IMPORTAR EN QUE MODO ESTEMOS. CONTAR LA HORA SE CUENTA CUANDO LA BANDERA ESTA ENCENDIDA
	LA TENGO CONFIGURADA DE TAL MODO QUE CUENTE EN TODOS LOS MODOS, MENOS EN CONFIGURAR HORA. UNA VEZ TERMINA DE CONTAR HORA Y TIEMPO, NOS ENVIA AL MODO
	QUE TOQUE SEGUN SE PRESIONE EL BOTON DE MODO. MI RELOJ CONSTA DE 5 MODOS.
		CONFIGURACION HORA
		MOSTRAR	HORA (EN ESTE MODO LOS BOTONES NO TIENEN NINGUNA FUNCION)
		COFIGURACION DE FECHA
		MOSTRAR FECHA
		CONFIGURACION DE ALARMA. (LA ALARMA SE SETTEA PRESIONANDO EL BOTON PB1 Y CUANDO SUENA SE APAGA PRESIONANDO EL MISMO)
*/
LOOP:
	MOV		R16, CONTADOR_PARPADEO
	CPI		R16, 100			//CADA MEDIO SEGUIDO
	BREQ	TOGGLEAR_PARPADEO
	RJMP	CONTAR_TIEMPO

TOGGLEAR_PARPADEO:
	SBI		PINB, PORTB0
	CLR		CONTADOR_PARPADEO
	
CONTAR_TIEMPO:
	SBRS	BANDERA_TIEMPO, 0			//SI LA BANDERA ESTA APAGADA, NO CONTAMOS EL TIEMPO Y NOS VAMOS AL LOOP2
	RJMP	LOOP2
	MOV		R16, SEGUNDERO
	CPI		R16, 1						//VERIFICAR QUE YA PASO UN MINUTO
	BREQ	AUMENTAR_UNIDADES_MIN
	RJMP	CONTAR_FECHA
AUMENTAR_UNIDADES_MIN:
	CLR		SEGUNDERO
	INC		UNIDADES_MIN
	MOV		R16,UNIDADES_MIN
	CPI		R16, 10	
	BREQ	AUMENTAR_DEC_MIN
	RJMP	CONTAR_FECHA
AUMENTAR_DEC_MIN:
	CLR		UNIDADES_MIN
	INC		DECENAS_MIN
	MOV		R16,DECENAS_MIN
	CPI		R16, 6
	BREQ	AUMENTAR_UNIDADES_HORAS
	RJMP	CONTAR_FECHA
AUMENTAR_UNIDADES_HORAS:
	CLR		DECENAS_MIN
	INC		UNIDADES_HORAS
	//HAY QUE REVISAR SI DECENAS HORAS ES 2, SI ES 2 LAS UNIDADES SOLO DEBEN LLEGAR A 4
	MOV		R16,DECENAS_HORAS
	CPI 	R16,2
	BREQ	LLEGAMOS_24H
	MOV		R16,UNIDADES_HORAS
	CPI		R16, 10	
	BREQ	AUMENTAR_DEC_HORAS
	RJMP	CONTAR_FECHA
LLEGAMOS_24H:
	MOV		R16,UNIDADES_HORAS
	CPI		R16, 4	
	BREQ	RESET_HORA
	RJMP	CONTAR_FECHA

AUMENTAR_DEC_HORAS:
	CLR		UNIDADES_HORAS
	INC		DECENAS_HORAS
	MOV		R16,DECENAS_HORAS
	CPI		R16, 3
	BREQ	RESET_HORA
	RJMP	CONTAR_FECHA
RESET_HORA:
	INC		UNIDADES_DIAS		//YA PASO 1 DIA
	CLR		UNIDADES_MIN
	CLR		DECENAS_MIN
	CLR		UNIDADES_HORAS
	CLR		DECENAS_HORAS
	RJMP	CONTAR_FECHA

CONTAR_FECHA:
	MOV		R16, DECENAS_MESES
	CPI		R16, 1
	BREQ	OCT_NOV_DEC
	MOV		R16,UNIDADES_MESES
	CPI		R16, 1
	BREQ	ENERO
	CPI		R16,2
	BREQ	FEBRERO
	CPI		R16,3
	BREQ	MARZO
	CPI		R16,4
	BREQ	ABRIL
	CPI		R16,5
	BREQ	MAYO
	CPI		R16,6
	BREQ	JUNIO
	CPI		R16,7
	BREQ	JULIO
	CPI		R16,8
	BREQ	AGOSTO
	CPI		R16,9
	BREQ	SEPTIEMBRE
	RJMP	LOOP2
OCT_NOV_DEC:
	MOV		R16,UNIDADES_MESES
	CPI		R16, 0
	BREQ	OCTUBRE
	CPI		R16,1
	BREQ	NOVIEMBRE
	CPI		R16,2
	BREQ	DICIEMBRE
ENERO:
	CALL	VERIFICAR_MES31
	RJMP	LOOP2
FEBRERO:
	MOV		R16,DECENAS_DIAS
	CPI		R16, 2
	BREQ	MES_28
	MOV		R16,UNIDADES_DIAS
	CPI		R16,9
	BREQ	AUMENTAR_DECENAS_DIAS
	RJMP	LOOP2
MARZO:
	CALL	VERIFICAR_MES31
	RJMP	LOOP2
ABRIL:
	CALL	VERIFICAR_MES30
	RJMP	LOOP2
MAYO:
	CALL	VERIFICAR_MES31
	RJMP	LOOP2
JUNIO:
	CALL	VERIFICAR_MES30
	RJMP	LOOP2
JULIO:
	CALL	VERIFICAR_MES31
	RJMP	LOOP2
AGOSTO:
	CALL	VERIFICAR_MES31
	RJMP	LOOP2
SEPTIEMBRE:
	CALL	VERIFICAR_MES30
	RJMP	LOOP2
OCTUBRE:
	CALL	VERIFICAR_MES31
	RJMP	LOOP2
NOVIEMBRE:
	CALL	VERIFICAR_MES30
	RJMP	LOOP2
DICIEMBRE:
	CALL	VERIFICAR_MES31
	RJMP	LOOP2

VERIFICAR_MES30:
	MOV		R16,DECENAS_DIAS
	CPI		R16, 3
	BREQ	MES_30
	MOV		R16,UNIDADES_DIAS
	CPI		R16,10
	BREQ	AUMENTAR_DECENAS_DIAS
	RET
MES_30:
	MOV		R16, UNIDADES_DIAS
	CPI		R16, 1		//SI YA PASO 30, AGREGO MES
	BREQ	AUMENTAR_UNIDADES_MESES
	//RJMP	LOOP2
	RET
VERIFICAR_MES31:
	MOV		R16,DECENAS_DIAS
	CPI		R16, 3
	BREQ	MES_31
	MOV		R16,UNIDADES_DIAS
	CPI		R16,10
	BREQ	AUMENTAR_DECENAS_DIAS
	RET
AUMENTAR_DECENAS_DIAS:
	CLR		UNIDADES_DIAS
	INC		DECENAS_DIAS
	RJMP	LOOP2
MES_28:
	MOV		R16,UNIDADES_DIAS
	CPI		R16,9
	BREQ	AUMENTAR_UNIDADES_MESES
	RJMP	LOOP2
MES_31:
    MOV		R16, UNIDADES_DIAS
	CPI		R16, 2				//SI YA PASO 31, AGREGO MES
	BREQ	AUMENTAR_UNIDADES_MESES
	//RJMP	LOOP2
	RET
AUMENTAR_UNIDADES_MESES:
	CLR		DECENAS_DIAS
	INC		UNIDADES_MESES
	MOV		R16,DECENAS_MESES
	CPI		R16, 1
	BREQ	DICIEMBRE_30
	LDI		R16, 1
	MOV		UNIDADES_DIAS,R16
	
	MOV		R16, UNIDADES_MESES
	CPI		R16, 10
	BREQ	AUMENTAR_DECENAS_MESES
	RJMP	LOOP2
AUMENTAR_DECENAS_MESES:
	CLR		UNIDADES_MESES
	INC		DECENAS_MESES
	RJMP	LOOP2

DICIEMBRE_30:
	MOV		R16, UNIDADES_MESES
	CPI		R16,3
	BREQ	R_FECHA
	RJMP	LOOP2
R_FECHA:
	LDI		R16, 1
	MOV		UNIDADES_DIAS, R16
	MOV		UNIDADES_MESES,R16
	CLR		DECENAS_DIAS
	CLR		DECENAS_MESES
	RJMP	LOOP2

LOOP2:
	CPI		MODO,0
	BREQ	SAL_CONF_HORA
	CPI		MODO,1
	BREQ	SAL_MODO_HORA
	CPI		MODO, 2
	BREQ	SAL_CONF_FECHA
	CPI		MODO,3
	BREQ	SAL_MODO_FECHA
	CPI		MODO, 4
	BREQ	SAL_CONF_ALARMA
	RJMP	LOOP

//--------------------------------------  ACA TERMINA EL MAIN LOOP  --------------------------------------
SAL_MODO_HORA:
	RJMP	MODO_HORA
SAL_CONF_HORA:
	RJMP	CONF_HORA
SAL_MODO_FECHA:
	RJMP	MODO_FECHA
SAL_CONF_FECHA:
	RJMP	CONF_FECHA
SAL_CONF_ALARMA:
	RJMP	CONF_ALARMA
	//----------------------------------------------------------MODO HORA----------------------------------------------------------
MODO_HORA:
	//------------------APAGAMOS LEDS--------------
	CBI		PORTC, PORTC5
	SBI		PORTC,PORTC4
	
	//-------------------------------------------------
	LDI		BANDERA_TIEMPO, 0B00000001
	CLR		BANDERA_CONFHORA
	CLR		BANDERA_CONFFECHA
	//CLR		BANDERA_CONFALARMA
	CALL	DISP_LEDS
	SBRC	BANDERA_CONFALARMA, 1	//BANDERA_CONFALARMA, OB 0000 0010
	CALL	VERIFICAR_ENCENDER_ALARMA
	RJMP	LOOP
//DISPLAY DE LEDS
DISP_LEDS:
	LDI		ZL, LOW(TABLA << 1)
	LDI		ZH, HIGH(TABLA << 1)
	CPI		TRANSISTORES, 0 //0B00001000
	BREQ	DISP1
	CPI		TRANSISTORES, 1 //0B00000100
	BREQ	DISP2
	CPI		TRANSISTORES, 2 //0B00000010
	BREQ	DISP3
	CPI		TRANSISTORES, 3 //0B00000001
	BREQ	DISP4
DISP1:	
	//DECENAS DE MINUTOS
	CBI		PORTC, PORTC0
	CBI		PORTC, PORTC1
	CBI		PORTC, PORTC2
	SBI		PORTC,PORTC3
	MOV		R16, UNIDADES_MIN
	ADD		ZL,R16
	ADC		ZH,R1
	RJMP	OUT_DISPLAY
DISP2:
	//UNIDADES HORAS
	CBI		PORTC, PORTC0
	CBI		PORTC, PORTC1
	SBI		PORTC, PORTC2
	CBI		PORTC,PORTC3
	MOV		R16, DECENAS_MIN
	ADD		ZL,R16
	ADC		ZH,R1
	RJMP	OUT_DISPLAY
DISP3:
	//DECENAS DE HORAS
	CBI		PORTC, PORTC0
	SBI		PORTC, PORTC1
	CBI		PORTC, PORTC2
	CBI		PORTC,PORTC3
	MOV		R16, UNIDADES_HORAS
	ADD		ZL,R16
	ADC		ZH,R1
	RJMP	OUT_DISPLAY
DISP4:
	//UNIDADES MINUTOS
	SBI		PORTC, PORTC0
	CBI		PORTC, PORTC1
	CBI		PORTC, PORTC2
	CBI		PORTC,PORTC3
	MOV		R16,DECENAS_HORAS
	ADD		ZL,R16
	ADC		ZH,R1
	RJMP	OUT_DISPLAY

OUT_DISPLAY:
	//ACA TENGO QUE CARGAR LA SALIDA Y REGRESAR AL LOOP
	LPM		R16,Z
	OUT		PORTD,R16
	RET
	
//------------------------------------------------------  MODO CONFIGURACION HORA  ------------------------------------------------------
CONF_HORA:
	//------------------LEDS CONF HORA--------------
	//SBI		PORTC, PORTC4
	CBI		PORTC, PORTC5
	MOV		R16, R26
	CPI		R16, 100				//CADA MEDIO SEGUIDO
	BREQ	TOGGLEAR_HORA
	RJMP	CONTINUAR_CONFHORA
TOGGLEAR_HORA:
	SBI		PINC, PORTC4
	CLR		R26
	//-------------------------------------------------
CONTINUAR_CONFHORA:
	LDI		BANDERA_CONFHORA, 0B00000001	//ENCENDEMOS BANDERA CONF HORA
	CLR		BANDERA_TIEMPO		//DEJAMOS DE CONTAR EL TIEMPO
	CLR		BANDERA_CONFFECHA
	//HACEMOS DISPLAY DEL RELOJ
	CALL	DISP_LEDS
	RJMP	LOOP


//-----------------------------------------------------  INICIA MODO FECHA  -----------------------------------------------------
MODO_FECHA:
	//------------------APAGAMOS LEDS--------------
	CBI		PORTC, PORTC4
	SBI		PORTC, PORTC5
	LDI		BANDERA_TIEMPO, 0X01		//CONTAMOS TIEMPO
	CLR		BANDERA_CONFFECHA
	CALL	DISP_FECHA
	SBRC	BANDERA_CONFALARMA, 1	//BANDERA_CONFALARMA, OB 0000 0010
	CALL	VERIFICAR_ENCENDER_ALARMA
	RJMP	LOOP
CONF_FECHA:
//------------------LEDS CONF FECHA--------------
	LDI		BANDERA_TIEMPO, 0X01		//CONTAMOS TIEMPO
	LDI		BANDERA_CONFFECHA,0X01		//BANDERA CONFIGURAR FECHA
	//CLR		BANDERA_CONFALARMA
	CBI		PORTC, PORTC4
	//SBI		PORTC, PORTC5
	MOV		R16, R26
	CPI		R16, 100				//CADA MEDIO SEGUIDO
	BREQ	TOGGLEAR_FECHA
	CALL	DISP_FECHA
	SBRC	BANDERA_CONFALARMA, 1	//BANDERA_CONFALARMA, OB 0000 0010
	CALL	VERIFICAR_ENCENDER_ALARMA
	RJMP	LOOP
TOGGLEAR_FECHA:
	SBI		PINC, PORTC5
	CLR		R26
	CALL	DISP_FECHA
	RJMP	LOOP

DISP_FECHA:
	LDI		ZL, LOW(TABLA << 1)
	LDI		ZH, HIGH(TABLA << 1)
	CPI		TRANSISTORES, 0 //0B00001000
	BREQ	DP1
	CPI		TRANSISTORES, 1 //0B00000100
	BREQ	DP2
	CPI		TRANSISTORES, 2 //0B00000010
	BREQ	DP3
	CPI		TRANSISTORES, 3 //0B00000001
	BREQ	DP4
DP1:	
	CBI		PORTC, PORTC0
	CBI		PORTC, PORTC1
	CBI		PORTC, PORTC2
	SBI		PORTC,PORTC3
	//MOV		R16, UNIDADES_DIAS
	MOV		R16, UNIDADES_MESES
	ADD		ZL,R16
	ADC		ZH,R1
	RJMP	OUT_DP
DP2:
	CBI		PORTC, PORTC0
	CBI		PORTC, PORTC1
	SBI		PORTC, PORTC2
	CBI		PORTC,PORTC3
	//MOV		R16, DECENAS_DIAS
	MOV		R16, DECENAS_MESES
	ADD		ZL,R16
	ADC		ZH,R1
	RJMP	OUT_DP
DP3:
	CBI		PORTC, PORTC0
	SBI		PORTC, PORTC1
	CBI		PORTC, PORTC2
	CBI		PORTC,PORTC3
	//MOV		R16, UNIDADES_MESES
	MOV		R16, UNIDADES_DIAS
	ADD		ZL,R16
	ADC		ZH,R1
	RJMP	OUT_DP
DP4:
	SBI		PORTC, PORTC0
	CBI		PORTC, PORTC1
	CBI		PORTC, PORTC2
	CBI		PORTC,PORTC3
	//MOV		R16,DECENAS_MESES
	MOV		R16, DECENAS_DIAS
	ADD		ZL,R16
	ADC		ZH,R1
	RJMP	OUT_DP

OUT_DP:
	//ACA TENGO QUE CARGAR LA SALIDA Y REGRESAR AL LOOP
	LPM		R16,Z
	OUT		PORTD,R16
	RET

CONF_ALARMA:
//------------------LEDS CONF ALARMA--------------
	//SBI		PORTC, PORTC4
	//SBI		PORTC, PORTC5
	SBRC	BANDERA_CONFALARMA, 1	//BANDERA_CONFALARMA, OB 0000 0010
	RJMP	ALARMA_CONFIGURADA
	MOV		R16, R26
	CPI		R16, 100				//CADA MEDIO SEGUIDO
	BREQ	TOGGLEAR_ALARMA
	RJMP	CONTINUAR_MODOALARMA
TOGGLEAR_ALARMA:
	SBI		PINC, PORTC4
	SBI		PINC, PORTC5
	CLR		R26
CONTINUAR_MODOALARMA:
	LDI		BANDERA_TIEMPO, 0X01		//CONTAMOS TIEMPO
	LDI		BANDERA_CONFALARMA, 0X01	//BANDERA ALARMA
	CLR		BANDERA_CONFFECHA
	CLR		BANDERA_CONFHORA
	CALL	DISP_ALARMA
	RJMP	LOOP
ALARMA_CONFIGURADA:
	SBI		PORTC, PORTC4
	SBI		PORTC, PORTC5
	CALL	VERIFICAR_ENCENDER_ALARMA
	CALL	DISP_ALARMA
	RJMP	LOOP
DISP_ALARMA:
	LDI		ZL, LOW(TABLA << 1)
	LDI		ZH, HIGH(TABLA << 1)
	CPI		TRANSISTORES, 0 //0B00001000
	BREQ	DISP1_ALARMA
	CPI		TRANSISTORES, 1 //0B00000100
	BREQ	DISP2_ALARMA
	CPI		TRANSISTORES, 2 //0B00000010
	BREQ	DISP3_ALARMA
	CPI		TRANSISTORES, 3 //0B00000001
	BREQ	DISP4_ALARMA
DISP1_ALARMA:	
	//DECENAS DE MINUTOS
	CBI		PORTC, PORTC0
	CBI		PORTC, PORTC1
	CBI		PORTC, PORTC2
	SBI		PORTC,PORTC3
	MOV		R16, UNIDADES_M_ALARMA
	ADD		ZL,R16
	ADC		ZH,R1
	RJMP	OUT_DISPLAY_ALARMA
DISP2_ALARMA:
	//UNIDADES HORAS
	CBI		PORTC, PORTC0
	CBI		PORTC, PORTC1
	SBI		PORTC, PORTC2
	CBI		PORTC,PORTC3
	MOV		R16, DECENAS_M_ALARMA
	ADD		ZL,R16
	ADC		ZH,R1
	RJMP	OUT_DISPLAY
DISP3_ALARMA:
	//DECENAS DE HORAS
	CBI		PORTC, PORTC0
	SBI		PORTC, PORTC1
	CBI		PORTC, PORTC2
	CBI		PORTC,PORTC3
	MOV		R16, UNIDADES_H_ALARMA
	ADD		ZL,R16
	ADC		ZH,R1
	RJMP	OUT_DISPLAY_ALARMA
DISP4_ALARMA:
	//UNIDADES MINUTOS
	SBI		PORTC, PORTC0
	CBI		PORTC, PORTC1
	CBI		PORTC, PORTC2
	CBI		PORTC,PORTC3
	MOV		R16,DECENAS_H_ALARMA
	ADD		ZL,R16
	ADC		ZH,R1
	RJMP	OUT_DISPLAY_ALARMA

OUT_DISPLAY_ALARMA:
	//ACA TENGO QUE CARGAR LA SALIDA Y REGRESAR AL LOOP
	LPM		R16,Z
	OUT		PORTD,R16
	RET

VERIFICAR_ENCENDER_ALARMA:
	CP		UNIDADES_M_ALARMA,UNIDADES_MIN
	BREQ	COMPARAR_DECENAS
	RJMP	REGRESAR_ENCENDER_ALARMA
COMPARAR_DECENAS:
	CP		DECENAS_MIN, DECENAS_M_ALARMA
	BREQ	COMPARAR_UNIDADES_HORAS
	RJMP	REGRESAR_ENCENDER_ALARMA
COMPARAR_UNIDADES_HORAS:
	CP		UNIDADES_HORAS, UNIDADES_H_ALARMA
	BREQ	COMPARAR_DECENAS_HORAS
	RJMP	REGRESAR_ENCENDER_ALARMA
COMPARAR_DECENAS_HORAS:
	CP		DECENAS_HORAS, DECENAS_H_ALARMA
	BREQ	ENCENDER_A
	RJMP	REGRESAR_ENCENDER_ALARMA
ENCENDER_A:
	SBI		PORTB, PORTB5
	LDI		BANDERA_CONFALARMA, 0B00000100
REGRESAR_ENCENDER_ALARMA:
	RET
//-----------------------------------------  RUTINAS DE TIMER  -----------------------------
INIT_TMR0:
    LDI     R16, (1<<CS01) | (1<<CS00)	// Setear prescaler del TIMER 0 a 64 TCCTBOB = 0000 0011
	//LDI		R16, (1<<CS02)| (1<<CS00)	//PRESCALER 1024
    OUT     TCCR0B, R16			
    LDI     R16, VALOR_TCNT0	// CON ESTE VALOR, TCNT0 ESTARA SET CADA 10MS      
    OUT     TCNT0, R16          // Cargar valor inicial en TCNT0
	RET
//-----------------------------------------BLOQUE DE INTERRUPCIONES-----------------------------------------
/*EXPLICACION DE LAS INTERRUPCIONES:
	LAS INTERRUPCIONES DE LOS BOTONES FUNCIONAN PARA INCREMENTAR O DECREMENTAR LA HORA, TANTO EN EL MODO DE ALARMA COMO EN MODO HORA.
	PARA LA CONFIGURACION DE FECHA OPTE POR UTILIZAR AMBOS BOTONES PARA INCREMENTAR, UNO INCREMENTE LOS MESES Y EL OTRO LOS DIAS.
	LA LOGICA PARA INCREMENTAR CORRECTAMENTE LOS MESES Y DIAS ESTA IMPLEMENTADA EN EL MAIN LOOP, POR LO QUE AQUI UNICAMENTE DEBO INCREMENTAR
	LA VARIABLE. LA HORA SI INCLUYE LA LOGICA PARA INCREMENTAR EN LA INTERRUPCION PORQUE EN MI MAIN LOOP CUANDO SE CONFIGURA LA HORA, NO SE CUENTA EL PASO DEL
	TIEMPO POR LO QUE DEBO VOLVER A IMPLEMENTAR LA LOGICA AQUI. 

	MI RUTINA DE TIMER HACE OVERFLOW CADA 5ms Y HAGO LA LOGICA PARA CONTAR 1 SEGUNDO. DE IGUAL MANERA EN CADA OVERFLOW INCREMENTO UNA VARIABLE PARA CONTROLAR LOS 
	TRANSISTORES, ES DECIR PARA HACER EL MULTIPLEXADP DE LOS DISPLAYS.
*/
ISR_ON_CHANGE:
	PUSH	R17
	IN		R17, SREG
	PUSH	R17

	SBIS	PINB, PORTB1
	RJMP	APAGAR_ALARMA
	SBIS	PINB, PORTB2
	RJMP	PB_RESTAR
	SBIS	PINB, PORTB3
	RJMP	PB_INCREMENTAR
	SBIS	PINB, PORTB4
	RJMP	CAMBIAR_MODO
	RJMP	SALIR_ISR_ONCHANGE
APAGAR_ALARMA:
	CPI		BANDERA_CONFALARMA, 0B00000100
	BREQ	APAGAR
	LDI		BANDERA_CONFALARMA, 0B00000010 //SI SE PRESIONA EL BOTON ES PORQUE LA ALARMA ESTA SETTEADA
	RJMP	SALIR_ISR_ONCHANGE

APAGAR:
	CBI		PORTB,PORTB5
	CLR		UNIDADES_M_ALARMA
	CLR		DECENAS_M_ALARMA
	CLR		UNIDADES_H_ALARMA
	CLR		DECENAS_H_ALARMA
	RJMP	SALIR_ISR_ONCHANGE

//----------------------------------------------------------BOTON DE RESTAR----------------------------------------------------------

PB_RESTAR:
	CPI		BANDERA_CONFHORA,1	//VERIFICAR SI ESTAMOS EN MODO CONF HORA
	BREQ	RESTAR_UNIDADES_MIN
	CPI		BANDERA_CONFALARMA,1
	BREQ	PB_RESTAR_ALARMA
	CPI		BANDERA_CONFFECHA,1
	BREQ	PB_INC_DECENAS_FECHA
	RJMP	SALIR_ISR_ONCHANGE
PB_INC_DECENAS_FECHA:
	INC		UNIDADES_MESES
	MOV		R17, DECENAS_MESES
	CPI		R17, 1
	BREQ	YA_ES_NAVIDAD
	MOV		R17, UNIDADES_MESES
	CPI		R17, 10
	BREQ	PB_SUMAR_DEC_MESES
	RJMP	SALIR_ISR_ONCHANGE
PB_SUMAR_DEC_MESES:
	CLR		UNIDADES_MESES
	INC		DECENAS_MESES
	RJMP	SALIR_ISR_ONCHANGE
YA_ES_NAVIDAD: //ACA YA ESTAMOS EN DICIEMBRE
	MOV		R17, UNIDADES_MESES
	CPI		R17,3
	BREQ	REINICIAR_NAVIDAD
	RJMP	SALIR_ISR_ONCHANGE
REINICIAR_NAVIDAD:
	LDI		R17, 1
	MOV		UNIDADES_MESES, R17
	CLR		DECENAS_MESES
RESTAR_UNIDADES_MIN:
	MOV		R17,UNIDADES_MIN
	CPI		R17, 0X00
	BREQ	RESTAR_DECENAS_MIN
	DEC		UNIDADES_MIN
	RJMP	SALIR_ISR_ONCHANGE	
RESTAR_DECENAS_MIN:
	LDI		R17,9
	MOV		UNIDADES_MIN, R17
	MOV		R17,DECENAS_MIN
	CPI		R17, 0X00
	BREQ	RESTAR_UNIDADES_HORAS
	DEC		DECENAS_MIN
	RJMP	SALIR_ISR_ONCHANGE	
RESTAR_UNIDADES_HORAS:
	LDI		R17,5
	MOV		DECENAS_MIN,R17
	MOV		R17,UNIDADES_HORAS
	CPI		R17, 0X00
	BREQ	RESTAR_DECENAS_HORAS
	DEC		UNIDADES_HORAS
	RJMP	SALIR_ISR_ONCHANGE	
RESTAR_DECENAS_HORAS:
	LDI		R17,9
	MOV		UNIDADES_HORAS,R17
	MOV		R17,DECENAS_HORAS
	CPI		R17, 0X00
	BREQ	LLENAR_HORAS
	DEC		DECENAS_HORAS
	RJMP	SALIR_ISR_ONCHANGE	
LLENAR_HORAS:	//ACA HAGO EL UNDERFLOW FINAL DE RESTAR 
	LDI		R17,9
	MOV		UNIDADES_MIN, R17
	LDI		R17,5
	MOV		DECENAS_MIN,R17
	LDI		R17,3
	MOV		UNIDADES_HORAS,R17
	LDI		R17,2
	MOV		DECENAS_HORAS, R17
	RJMP	SALIR_ISR_ONCHANGE

PB_RESTAR_ALARMA:
	MOV		R17,UNIDADES_M_ALARMA
	CPI		R17, 0X00
	BREQ	RESTAR_DECENAS_MIN_ALARMA
	DEC		UNIDADES_M_ALARMA
	RJMP	SALIR_ISR_ONCHANGE	
RESTAR_DECENAS_MIN_ALARMA:
	LDI		R17,9
	MOV		UNIDADES_M_ALARMA, R17
	MOV		R17,DECENAS_M_ALARMA
	CPI		R17, 0X00
	BREQ	RESTAR_UNIDADES_HORAS_ALARMA
	DEC		DECENAS_M_ALARMA
	RJMP	SALIR_ISR_ONCHANGE	
RESTAR_UNIDADES_HORAS_ALARMA:
	LDI		R17,5
	MOV		DECENAS_M_ALARMA,R17
	MOV		R17,UNIDADES_H_ALARMA
	CPI		R17, 0X00
	BREQ	RESTAR_DECENAS_HORAS_ALARMA
	DEC		UNIDADES_H_ALARMA
	RJMP	SALIR_ISR_ONCHANGE	
RESTAR_DECENAS_HORAS_ALARMA:
	LDI		R17,9
	MOV		UNIDADES_H_ALARMA,R17
	MOV		R17,DECENAS_H_ALARMA
	CPI		R17, 0X00
	BREQ	LLENAR_HORAS_ALARMA
	DEC		DECENAS_H_ALARMA
	RJMP	SALIR_ISR_ONCHANGE	
LLENAR_HORAS_ALARMA:	//ACA HAGO EL UNDERFLOW FINAL DE RESTAR 
	LDI		R17,9
	MOV		UNIDADES_M_ALARMA, R17
	LDI		R17,5
	MOV		DECENAS_M_ALARMA,R17
	LDI		R17,3
	MOV		UNIDADES_H_ALARMA,R17
	LDI		R17,2
	MOV		DECENAS_H_ALARMA, R17
	RJMP	SALIR_ISR_ONCHANGE

//----------------------------------------------------------BOTON DE INCREMENTAR----------------------------------------------------------
PB_INCREMENTAR:
	
	CPI		BANDERA_CONFHORA,1	//VERIFICAR SI ESTAMOS EN MODO CONF HORA
	BREQ	INC_UNIDADES_MIN
	CPI		BANDERA_CONFFECHA,1
	BREQ	PB_INC_FECHA
	CPI		BANDERA_CONFALARMA,1
	BREQ	PB_SUMAR_ALARMA
	RJMP	SALIR_ISR_ONCHANGE
PB_INC_FECHA:
	INC		UNIDADES_DIAS
	RJMP	SALIR_ISR_ONCHANGE
INC_UNIDADES_MIN:
	MOV		R17,UNIDADES_MIN
	CPI		R17, 9
	BREQ	INC_DECENAS_MIN
	INC		UNIDADES_MIN
	RJMP	SALIR_ISR_ONCHANGE	
INC_DECENAS_MIN:
	CLR		UNIDADES_MIN
	MOV		R17,DECENAS_MIN
	CPI		R17, 5
	BREQ	INC_UNIDADES_HORAS
	INC		DECENAS_MIN
	RJMP	SALIR_ISR_ONCHANGE	
INC_UNIDADES_HORAS:
	CLR		DECENAS_MIN
	MOV		R17, DECENAS_HORAS
	CPI		R17, 2	//VERIFICAR SI YA ESTAMOS CERCA DE 24H
	BREQ	INC_24HORAS
	MOV		R17,UNIDADES_HORAS
	CPI		R17, 9
	BREQ	INC_DECENAS_HORAS
	INC		UNIDADES_HORAS
	RJMP	SALIR_ISR_ONCHANGE	
INC_24HORAS:
	MOV		R17,UNIDADES_HORAS
	CPI		R17, 3
	BRGE	VACIAR_HORAS
	INC		UNIDADES_HORAS
	RJMP	SALIR_ISR_ONCHANGE	
INC_DECENAS_HORAS:
	CLR		UNIDADES_HORAS
	MOV		R17,DECENAS_HORAS
	CPI		R17, 2
	BREQ	VACIAR_HORAS
	INC		DECENAS_HORAS
	RJMP	SALIR_ISR_ONCHANGE	
VACIAR_HORAS:				//ACA HAGO EL UNDERFLOW FINAL DE RESTAR 
	CLR		UNIDADES_MIN
	CLR		DECENAS_MIN
	CLR		UNIDADES_HORAS
	CLR		DECENAS_HORAS
	RJMP	SALIR_ISR_ONCHANGE

PB_SUMAR_ALARMA:
	INC		UNIDADES_M_ALARMA
	//MOV		R16,DECENAS_H_ALARMA
	//CPI 	R16,2
	//BREQ	LLEGAMOS_24H_ALARMA
	MOV		R16,UNIDADES_M_ALARMA
	CPI		R16, 10	
	BREQ	AUMENTAR_DEC_MIN_ALARMA
	RJMP	SALIR_ISR_ONCHANGE
AUMENTAR_DEC_MIN_ALARMA:
	CLR		UNIDADES_M_ALARMA
	INC		DECENAS_M_ALARMA
	MOV		R16,DECENAS_M_ALARMA
	CPI		R16, 6
	BREQ	AUMENTAR_UNIDADES_HORAS_ALARMA
	RJMP	SALIR_ISR_ONCHANGE
AUMENTAR_UNIDADES_HORAS_ALARMA:
	CLR		DECENAS_M_ALARMA
	INC		UNIDADES_H_ALARMA
	//HAY QUE REVISAR SI DECENAS HORAS ES 2, SI ES 2 LAS UNIDADES SOLO DEBEN LLEGAR A 4
	MOV		R16,DECENAS_H_ALARMA
	CPI 	R16,2
	BREQ	LLEGAMOS_24H_ALARMA
	MOV		R16,UNIDADES_H_ALARMA
	CPI		R16, 10	
	BREQ	AUMENTAR_DEC_HORAS_ALARMA
	RJMP	SALIR_ISR_ONCHANGE
LLEGAMOS_24H_ALARMA:
	MOV		R16,UNIDADES_H_ALARMA
	CPI		R16, 3	
	BRGE	RESET_HORA_ALARMA
	RJMP	SALIR_ISR_ONCHANGE

AUMENTAR_DEC_HORAS_ALARMA:
	CLR		UNIDADES_H_ALARMA
	INC		DECENAS_H_ALARMA
	MOV		R16,DECENAS_H_ALARMA
	CPI		R16, 3
	BREQ	RESET_HORA_ALARMA
	RJMP	SALIR_ISR_ONCHANGE
RESET_HORA_ALARMA:
	CLR		UNIDADES_M_ALARMA
	CLR		DECENAS_M_ALARMA
	CLR		UNIDADES_H_ALARMA
	CLR		DECENAS_H_ALARMA
	RJMP	SALIR_ISR_ONCHANGE

//----------------------------------------------------------BOTON CAMBIAR DE MODO----------------------------------------------------------
CAMBIAR_MODO:
	MOV		R17, MODO
	CPI		R17, CANTIDAD_MODOS
	BREQ	LIMPIAR_MODOS
	INC		MODO
	RJMP	SALIR_ISR_ONCHANGE
LIMPIAR_MODOS:
	CLR		MODO
	RJMP	SALIR_ISR_ONCHANGE
SALIR_ISR_ONCHANGE:
	POP		R17
	OUT		SREG, R17
	POP		R17
	RETI

//-----------------------------------------------------  INTERRUPCION TIMER0  -----------------------------------------------------
ISR_TIMER0:
	PUSH	R17
	IN		R17, SREG
	PUSH	R17
	LDI     R17, VALOR_TCNT0				//CADA 5ms
    OUT     TCNT0, R17						// Volver a cargar valor inicial en TCNT0
	INC		COUNTER
	INC		CONTADOR_PARPADEO
	INC		R26
	CPI		COUNTER, 200					//200 SALTA SI YA PASO UN SEGUNDO
	BREQ	YA_PASO_UN_SEGUNDO
	RJMP	SALIR_ISR_TIMER0
YA_PASO_UN_SEGUNDO:
	CLR		COUNTER
	LDI		R17, 0
	CPSE	BANDERA_TIEMPO, R17
	INC		SEGUNDERO
	INC		COUNTER_ALARMA
SALIR_ISR_TIMER0:
	INC		TRANSISTORES
	SBRC	TRANSISTORES, 2		//LLEGO A 4
	CLR		TRANSISTORES
	POP		R17
	OUT		SREG, R17
	POP		R17
	RETI